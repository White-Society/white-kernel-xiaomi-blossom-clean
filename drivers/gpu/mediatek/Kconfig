## drivers/gpu/mediatek/Kconfig
```kconfig
config MEDIATEK_GPU
	bool "MediaTek PowerVR Rogue GPU support"
	depends on ARM64
	default y
	help
	  Enable support for MediaTek PowerVR Rogue GPU (MT6765 / GE8320).

config MTK_GPU_SUPPORT_MT6765
	bool "MT6765 GPU support"
	depends on MEDIATEK_GPU
	default y
```

## drivers/misc/mediatek/Kconfig
```kconfig
config MACH_MT6765
    bool "MediaTek MT6765"
    default n

config USB_MTK_HDRC
    tristate "MediaTek MUSB support"
    default n

config MTK_PLATFORM
    string "MTK platform name"
    default "mt6765"

source "drivers/misc/mediatek/usb20/Kconfig"

source "drivers/misc/mediatek/video/Kconfig"

source "drivers/misc/mediatek/cmdq/Kconfig"

source "drivers/misc/mediatek/ext_disp/Kconfig"

source "drivers/misc/mediatek/sync/Kconfig"
source "drivers/misc/mediatek/m4u/Kconfig"

config MTK_LCM
    bool "MediaTek LCM support"
    default n
    help
      Enable MediaTek LCM (LCD Module) driver support.

config MMPROFILE
    bool "MediaTek MM Profile support"
    default n

config CUSTOM_KERNEL_LCM
    string "Custom kernel LCM list"
    default ""
```

## drivers/staging/android/Kconfig
```kconfig
# SPDX-License-Identifier: GPL-2.0
menu "Android"

if ANDROID

config ASHMEM
	bool "Enable the Anonymous Shared Memory Subsystem"
	depends on SHMEM
	help
	  The ashmem subsystem is a new shared memory allocator, similar to
	  POSIX SHM but with different behavior and sporting a simpler
	  file-based API.

	  It is, in theory, a good memory allocator for low-memory devices,
	  because it can discard shared memory units when under memory pressure.

config DEBUG_KINFO
	bool "Debug Kernel Information Support"
	depends on KALLSYMS
	help
	  This supports kernel information backup for bootloader usage.
	  Specifics:
	   - The kallsyms symbols for unwind_backtrace
	   - Page directory pointer
	   - UTS_RELEASE
	   - BUILD_INFO(ro.build.fingerprint)

config MTK_ION
    bool "MediaTek ION driver"
    default n
    help
      MediaTek ION driver support for multimedia memory allocation.

config MTK_ION_DEBUG
    bool "MediaTek ION debug support"
    depends on MTK_ION
    default n

config MTK_ION_SEC_HEAP
    bool "MediaTek ION secure heap"
    depends on MTK_ION
    default n

source "drivers/staging/android/ion/Kconfig"

endif # if ANDROID

endmenu
```
